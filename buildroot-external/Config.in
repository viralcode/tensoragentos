## buildroot-external/Config.in
```kconfig
source "$BR2_EXTERNAL_AINUX_PATH/package/ainux-chromium/Config.in"
source "$BR2_EXTERNAL_AINUX_PATH/package/ainux-openwhale/Config.in"
source "$BR2_EXTERNAL_AINUX_PATH/package/ainux-shell/Config.in"
source "$BR2_EXTERNAL_AINUX_PATH/package/ainux-gui/Config.in"
```

## buildroot-external/package/ainux-chromium/Config.in
```kconfig
config BR2_PACKAGE_AINUX_CHROMIUM
	bool "ainux-chromium"
	depends on BR2_PACKAGE_MESA3D
	depends on BR2_PACKAGE_WAYLAND
	help
	  Chromium browser built from source with WebMCP
	  (navigator.modelContext) enabled by default.
	  Includes AInux patches for kiosk mode and deep CDP hooks.
```

## buildroot-external/package/ainux-gui/Config.in
```kconfig
config BR2_PACKAGE_AINUX_GUI
	bool "ainux-gui"
	depends on BR2_PACKAGE_NODEJS
	help
	  AInux agentic GUI — React-based interface served by
	  OpenWhale's dashboard, with agent grid, command palette,
	  task streams, and WebMCP bridge panel.
```

## buildroot-external/package/ainux-openwhale/Config.in
```kconfig
config BR2_PACKAGE_AINUX_OPENWHALE
	bool "ainux-openwhale"
	depends on BR2_PACKAGE_NODEJS
	help
	  OpenWhale — Self-Extensible Multi-Agent AI Assistant.
	  Cloned from github.com/viralcode/openwhale and installed
	  with pnpm. Runs as a systemd service on port 7777.
```

## buildroot-external/package/ainux-shell/Config.in
```kconfig
config BR2_PACKAGE_AINUX_SHELL
	bool "ainux-shell"
	depends on BR2_PACKAGE_CAGE
	help
	  AInux shell — boots directly into the agentic GUI via
	  Cage Wayland compositor running a fullscreen Chromium.
```

## configs/ainux_defconfig
```kconfig
#
# AInux Buildroot defconfig
#
# Uses Buildroot to create a minimal but complete Linux rootfs
# with full hardware support (graphics, audio, network, USB)
# 
# Build: make BR2_EXTERNAL=/path/to/ainux/buildroot-external ainux_defconfig && make
#

# ─── Target Architecture ────────────────────────────────────────────────────
BR2_x86_64=y
BR2_x86_x86_64=y

# ─── Toolchain ──────────────────────────────────────────────────────────────
BR2_TOOLCHAIN_EXTERNAL=y
BR2_TOOLCHAIN_EXTERNAL_DOWNLOAD=y
BR2_TOOLCHAIN_EXTERNAL_GDB_SERVER_COPY=y
BR2_TOOLCHAIN_EXTERNAL_GLIBC=y

# ─── Kernel ─────────────────────────────────────────────────────────────────
BR2_LINUX_KERNEL=y
BR2_LINUX_KERNEL_LATEST_VERSION=y
BR2_LINUX_KERNEL_USE_CUSTOM_CONFIG=y
BR2_LINUX_KERNEL_CUSTOM_CONFIG_FILE="$(BR2_EXTERNAL_AINUX_PATH)/configs/kernel.config"
BR2_LINUX_KERNEL_INSTALL_TARGET=y
BR2_LINUX_KERNEL_NEEDS_HOST_OPENSSL=y

# ─── Bootloader ─────────────────────────────────────────────────────────────
BR2_TARGET_GRUB2=y
BR2_TARGET_GRUB2_X86_64_EFI=y
BR2_TARGET_GRUB2_BUILTIN_MODULES_EFI="boot linux ext2 fat part_msdos part_gpt normal efi_gop"
BR2_TARGET_GRUB2_INSTALL_TOOLS=y

# ─── Root Filesystem ────────────────────────────────────────────────────────
BR2_TARGET_ROOTFS_EXT2=y
BR2_TARGET_ROOTFS_EXT2_4=y
BR2_TARGET_ROOTFS_EXT2_SIZE="4G"
BR2_TARGET_ROOTFS_ISO9660=y
BR2_TARGET_ROOTFS_ISO9660_BOOT_MENU="$(BR2_EXTERNAL_AINUX_PATH)/board/ainux/grub.cfg"
BR2_ROOTFS_OVERLAY="$(BR2_EXTERNAL_AINUX_PATH)/rootfs-overlay"
BR2_ROOTFS_POST_BUILD_SCRIPT="$(BR2_EXTERNAL_AINUX_PATH)/scripts/post-build.sh"
BR2_ROOTFS_POST_IMAGE_SCRIPT="$(BR2_EXTERNAL_AINUX_PATH)/scripts/post-image.sh"

# ─── Init System: systemd ───────────────────────────────────────────────────
BR2_INIT_SYSTEMD=y
BR2_PACKAGE_SYSTEMD_LOGIND=y
BR2_PACKAGE_SYSTEMD_NETWORKD=y
BR2_PACKAGE_SYSTEMD_RESOLVED=y
BR2_PACKAGE_SYSTEMD_TIMEDATED=y
BR2_PACKAGE_SYSTEMD_TIMESYNCD=y
BR2_PACKAGE_SYSTEMD_JOURNAL_GATEWAY=y

# ─── Core System ────────────────────────────────────────────────────────────
BR2_PACKAGE_BUSYBOX=y
BR2_PACKAGE_BASH=y
BR2_PACKAGE_COREUTILS=y
BR2_PACKAGE_UTIL_LINUX=y
BR2_PACKAGE_PROCPS_NG=y
BR2_PACKAGE_HTOP=y
BR2_PACKAGE_LESS=y
BR2_PACKAGE_VIM=y
BR2_PACKAGE_NANO=y
BR2_PACKAGE_CURL=y
BR2_PACKAGE_WGET=y
BR2_PACKAGE_FILE=y
BR2_PACKAGE_TAR=y
BR2_PACKAGE_GZIP=y
BR2_PACKAGE_XZ=y
BR2_PACKAGE_ZSTD=y
BR2_PACKAGE_OPENSSH=y
BR2_PACKAGE_SUDO=y
BR2_PACKAGE_SHADOW=y
BR2_PACKAGE_E2FSPROGS=y
BR2_PACKAGE_DOSFSTOOLS=y
BR2_PACKAGE_PARTED=y

# ─── Development Tools ──────────────────────────────────────────────────────
BR2_PACKAGE_GIT=y
BR2_PACKAGE_MAKE=y
BR2_PACKAGE_PKGCONF=y
BR2_PACKAGE_CMAKE=y

# ─── Graphics / Wayland ─────────────────────────────────────────────────────
# Mesa (OpenGL / Vulkan for Intel, AMD, VirtIO)
BR2_PACKAGE_MESA3D=y
BR2_PACKAGE_MESA3D_GALLIUM_DRIVER_I915=y
BR2_PACKAGE_MESA3D_GALLIUM_DRIVER_IRIS=y
BR2_PACKAGE_MESA3D_GALLIUM_DRIVER_RADEONSI=y
BR2_PACKAGE_MESA3D_GALLIUM_DRIVER_NOUVEAU=y
BR2_PACKAGE_MESA3D_GALLIUM_DRIVER_VIRGL=y
BR2_PACKAGE_MESA3D_GALLIUM_DRIVER_SWRAST=y
BR2_PACKAGE_MESA3D_VULKAN_DRIVER_INTEL=y
BR2_PACKAGE_MESA3D_VULKAN_DRIVER_RADEON=y
BR2_PACKAGE_MESA3D_OPENGL_ES=y
BR2_PACKAGE_MESA3D_OPENGL_EGL=y
BR2_PACKAGE_MESA3D_GBM=y
BR2_PACKAGE_MESA3D_DRI3=y

# Wayland
BR2_PACKAGE_WAYLAND=y
BR2_PACKAGE_WAYLAND_PROTOCOLS=y
BR2_PACKAGE_WESTON=y
BR2_PACKAGE_WESTON_DRM=y

# Cage (kiosk Wayland compositor — single fullscreen window)
BR2_PACKAGE_CAGE=y

# libinput / libdrm
BR2_PACKAGE_LIBDRM=y
BR2_PACKAGE_LIBINPUT=y
BR2_PACKAGE_LIBEVDEV=y
BR2_PACKAGE_EUDEV=y
BR2_PACKAGE_XKEYBOARD_CONFIG=y
BR2_PACKAGE_LIBXKBCOMMON=y

# Fonts
BR2_PACKAGE_FONTCONFIG=y
BR2_PACKAGE_DEJAVU_FONTS=y
BR2_PACKAGE_GOOGLE_FONTS=y

# ─── Audio ──────────────────────────────────────────────────────────────────
BR2_PACKAGE_ALSA_LIB=y
BR2_PACKAGE_ALSA_UTILS=y
BR2_PACKAGE_PIPEWIRE=y
BR2_PACKAGE_PIPEWIRE_ALSA=y
BR2_PACKAGE_PIPEWIRE_JACK=y
BR2_PACKAGE_WIREPLUMBER=y

# ─── Network ────────────────────────────────────────────────────────────────
BR2_PACKAGE_DHCPCD=y
BR2_PACKAGE_IW=y
BR2_PACKAGE_WPA_SUPPLICANT=y
BR2_PACKAGE_WPA_SUPPLICANT_AUTOSCAN=y
BR2_PACKAGE_WPA_SUPPLICANT_EAP=y
BR2_PACKAGE_WPA_SUPPLICANT_HOTSPOT=y
BR2_PACKAGE_WPA_SUPPLICANT_DBUS=y
BR2_PACKAGE_IPROUTE2=y
BR2_PACKAGE_IPTABLES=y
BR2_PACKAGE_NFTABLES=y
BR2_PACKAGE_DNSMASQ=y
BR2_PACKAGE_AVAHI=y
BR2_PACKAGE_CA_CERTIFICATES=y
BR2_PACKAGE_BLUEZ5_UTILS=y
BR2_PACKAGE_BLUEZ5_UTILS_CLIENT=y
BR2_PACKAGE_BLUEZ5_UTILS_OBEX=y
BR2_PACKAGE_LINUX_FIRMWARE=y
BR2_PACKAGE_LINUX_FIRMWARE_IWLWIFI_8265=y
BR2_PACKAGE_LINUX_FIRMWARE_IWLWIFI_9000=y
BR2_PACKAGE_LINUX_FIRMWARE_IWLWIFI_AX200=y
BR2_PACKAGE_LINUX_FIRMWARE_IWLWIFI_AX210=y
BR2_PACKAGE_LINUX_FIRMWARE_ATHEROS_10K=y
BR2_PACKAGE_LINUX_FIRMWARE_RALINK=y
BR2_PACKAGE_LINUX_FIRMWARE_REALTEK_RTL8XXX=y
BR2_PACKAGE_LINUX_FIRMWARE_MEDIATEK_MT7921=y
BR2_PACKAGE_LINUX_FIRMWARE_MEDIATEK_MT7922=y

# ─── Node.js Runtime ────────────────────────────────────────────────────────
BR2_PACKAGE_NODEJS=y
BR2_PACKAGE_NODEJS_NPM=y

# ─── Python (for AI/ML tools) ───────────────────────────────────────────────
BR2_PACKAGE_PYTHON3=y
BR2_PACKAGE_PYTHON3_PIP=y
BR2_PACKAGE_PYTHON3_SSL=y

# ─── Database ───────────────────────────────────────────────────────────────
BR2_PACKAGE_SQLITE=y

# ─── Libraries ──────────────────────────────────────────────────────────────
BR2_PACKAGE_OPENSSL=y
BR2_PACKAGE_LIBCURL=y
BR2_PACKAGE_LIBPNG=y
BR2_PACKAGE_LIBJPEG=y
BR2_PACKAGE_LIBWEBP=y
BR2_PACKAGE_FREETYPE=y
BR2_PACKAGE_HARFBUZZ=y
BR2_PACKAGE_PANGO=y
BR2_PACKAGE_CAIRO=y
BR2_PACKAGE_DBUS=y
BR2_PACKAGE_LIBUDEV=y
BR2_PACKAGE_LIBFFI=y
BR2_PACKAGE_ZLIB=y
BR2_PACKAGE_LZ4=y

# ─── Container / Sandboxing ─────────────────────────────────────────────────
BR2_PACKAGE_CONTAINERD=y
BR2_PACKAGE_RUNC=y

# ─── Hostname / User ────────────────────────────────────────────────────────
BR2_TARGET_GENERIC_HOSTNAME="ainux"
BR2_TARGET_GENERIC_ISSUE="Welcome to AInux — AI Agentic OS"
BR2_TARGET_GENERIC_ROOT_PASSWD="ainux"
BR2_TARGET_GENERIC_GETTY_PORT="tty1"
BR2_TARGET_GENERIC_REMOUNT_ROOTFS_RW=y
BR2_SYSTEM_BIN_SH_BASH=y
BR2_SYSTEM_DEFAULT_PATH="/usr/local/bin:/usr/bin:/bin:/opt/ainux/bin"
BR2_TARGET_TZ_INFO=y
BR2_TARGET_LOCALTIME="America/New_York"
```
